## CMakeLists.txt
```
# SPDX-License-Identifier: Apache-2.0
#
# Application-core image used when timer_dppi_spim runs on the FLPR: it starts the
# FLPR (nordic-flpr snippet, like Zephyr's default vpr_launcher) and, unlike
# the default one, requests the HFXO so the TIMER on the FLPR side runs from
# the crystal.

cmake_minimum_required(VERSION 3.20.0)

find_package(Zephyr REQUIRED HINTS $ENV{ZEPHYR_BASE})
project(hfxo_launcher)

target_sources(app PRIVATE src/main.c)
```

## prj.conf
```kconfig
CONFIG_CLOCK_CONTROL=y
CONFIG_LOG=n
CONFIG_CONSOLE=n
CONFIG_UART_CONSOLE=n
CONFIG_SERIAL=n
```

## src/main.c
```c
/*
 * hfxo_launcher: application-core side of the FLPR builds.
 *
 * The FLPR is started by the nordic-flpr snippet's VPR launcher at boot. The
 * FLPR has no clock-control driver in NCS 3.4.1, so the HFXO is requested
 * here and held forever; the FLPR's TIMER then runs from the crystal.
 */
#include <zephyr/kernel.h>
#include <zephyr/drivers/clock_control/nrf_clock_control.h>
#include <zephyr/sys/onoff.h>

int main(void)
{
	static struct onoff_client cli;
	struct onoff_manager *mgr = z_nrf_clock_control_get_onoff(CLOCK_CONTROL_NRF_SUBSYS_HF);

	sys_notify_init_spinwait(&cli.notify);
	(void)onoff_request(mgr, &cli);

	while (1) {
		k_sleep(K_FOREVER);
	}
	return 0;
}
```
